/* SPDX-License-Identifier: MIT
 * One keymap for this Toucan-only project, including shield fallback builds.
 * Original Beekeeb keymap: reference/baseline/shield-toucan.keymap.
 */
#include "../../../config/toucan.keymap"
