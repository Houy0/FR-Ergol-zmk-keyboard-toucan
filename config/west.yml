## config/west.yml
```yaml
# Official Toucan v1 baseline: source revisions resolved on 2026-11-01.
# Existing dependencies are repeated explicitly to preserve nanopb precedence
# over Zephyr's optional submanifest. Do not add clone-depth to SHA revisions.
manifest:
  projects:
    - name: zmk
      url: https://github.com/zmkfirmware/zmk
      revision: edf5c0814fd3ea202e43aad2d68fd32e882a518c
      path: zmk
      import: app/west.yml
    - name: zephyr
      url: https://github.com/zmkfirmware/zephyr
      revision: dacab4875df72109b96cc8977547a0dc04875bcd
      path: zephyr
      import:
        name-blocklist:
          - ci-tools
          - hal_altera
          - hal_cypress
          - hal_infineon
          - hal_microchip
          - hal_nxp
          - hal_openisa
          - hal_silabs
          - hal_xtensa
          - hal_st
          - hal_ti
          - loramac-node
          - mcuboot
          - mcumgr
          - net-tools
          - openthread
          - edtt
          - trusted-firmware-m
    - name: nanopb
      url: https://github.com/zmkfirmware/nanopb
      revision: 8c60555d6277a0360c876bd85d491fc4fb0cd74a
      path: modules/lib/nanopb
    - name: zmk-studio-messages
      url: https://github.com/zmkfirmware/zmk-studio-messages
      revision: 6cb4c283e76209d59c45fbcb218800cd19e9339d
      path: modules/msgs/zmk-studio-messages
    - name: cirque-input-module
      url: https://github.com/geeksville/cirque-input-module
      revision: effec100f0cd3a38e7fba3adfea394586cc84cab
      path: cirque-input-module
    - name: zmk-rgbled-widget
      url: https://github.com/caksoylar/zmk-rgbled-widget
      revision: 8756cb7b8114069fa3c25c6f6c990f24988fceff
      path: zmk-rgbled-widget
  self:
    path: config
```
